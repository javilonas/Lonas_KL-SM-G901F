## arch/arm/configs/apq8084_sec_userdebug_defconfig
```kconfig
# Overriding the rooting prevention feature as disable on ENG build
CONFIG_SEC_RESTRICT_ROOTING=y
CONFIG_SEC_RESTRICT_SETUID=y
CONFIG_SEC_RESTRICT_FORK=y
CONFIG_SEC_RESTRICT_ROOTING_LOG=y
# CONFIG_IKCONFIG is not set
# CONFIG_IKCONFIG_PROC is not set
```

## arch/arm/configs/tima_defconfig
```kconfig
# CONFIG_KNOX_KAP is not set
# CONFIG_TIMA_RKP is not set
# CONFIG_TIMA is not set
CONFIG_TIMA_LKMAUTH=y
CONFIG_TIMA_LKMAUTH_CODE_PROT=y
# CONFIG_TIMA_TEST_INFRA is not set
```

## drivers/staging/mhi/Kconfig
```kconfig
comment "Qualcomm MHI module edited by samsung"

config QCOM_MHI
	tristate "Qualcomm MHI module for S5 Plus (SM-G901F)"
	default n
	help
	  This is the support for samsungs mhi.ko module, taken from the opensource release G901FXXU1BOE2
```

## drivers/staging/qcacld-2.0/Kconfig
```kconfig
comment "Qualcomm Atheros CLD WLAN module"

config QCA_CLD_WLAN

	tristate "Qualcomm Atheros CLD WLAN module"
	default n
	help
	Add support for the Qualcomm Atheros CLD WLAN module

if QCA_CLD_WLAN != n

config PRIMA_WLAN_LFR
	bool "Enable the Prima WLAN Legacy Fast Roaming feature"
	default n

config PRIMA_WLAN_OKC
	bool "Enable the Prima WLAN Opportunistic Key Caching feature"
	default n

config PRIMA_WLAN_11AC_HIGH_TP
	bool "Enable the Prima WLAN 802.11ac High Throughput option (depends upon kernel support)"
	default n

config WLAN_FEATURE_11W
	bool "Enable the WLAN 802.11w Protected Management Frames feature"
	default n

config QCOM_VOWIFI_11R
	bool "Enable Fast Transition (11r) feature"
	default n

config CONFIG_ENABLE_LINUX_REG
	bool "Enable linux regulatory feature"
	default n

config QCOM_TDLS
	bool "Enable TDLS feature"
	default n

config QCOM_LTE_COEX
	bool "Enable QCOM LTE Coex feature"
	default n

endif # QCA_CLD_WLAN
```

## drivers/video/adf/Kconfig
```kconfig
menuconfig ADF
	depends on SYNC
	depends on DMA_SHARED_BUFFER
	tristate "Atomic Display Framework"

menuconfig ADF_FBDEV
	depends on ADF
	depends on FB
	tristate "Helper for implementing the fbdev API in ADF drivers"
```
